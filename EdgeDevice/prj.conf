## CMakeLists.txt
```
cmake_minimum_required(VERSION 3.20.0)

set(BOARD nrf52840dk_nrf52840)
#set(BOARD sam_v71_xult)

find_package(Zephyr REQUIRED HINTS  $ENV{ZEPHYR_BASE})
project(my_app)


target_sources(app 
	PRIVATE 
		src/main.c
		c25519/src/c25519.c
		c25519/src/ed25519.c
		c25519/src/f25519.c
		c25519/src/sha256.c
		c25519/src/utils.c
		$ENV{ZEPHYR_BASE}/lib/libc/minimal/source/stdlib/rand.c
)
```

## prj.conf
```kconfig
CONFIG_TIMING_FUNCTIONS=y
```

## src/main.c
```c
#include <zephyr.h>
#include <sys/printk.h>

#include <stdio.h>
#include <stdlib.h>
#include <timing/timing.h>

#include "../c25519/src/c25519.h"
#include "../c25519/src/ed25519.h"
#include "../c25519/src/sha256.h"

 // Key Manager Functions
uint8_t SK_S[ED25519_EXPONENT_SIZE];
uint8_t pks_x[F25519_SIZE];
uint8_t pks_y[F25519_SIZE];
struct ed25519_pt PK_S;

//Parameters for User A
uint8_t SK_A[ED25519_EXPONENT_SIZE], tk_a[ED25519_EXPONENT_SIZE];
uint8_t tka_x[F25519_SIZE], tka_y[F25519_SIZE];
struct ed25519_pt TK_A;

//Rekey Parameters
uint8_t rka_x[F25519_SIZE], rka_y[F25519_SIZE];
struct ed25519_pt RKA_S;

//Hash Parameters
uint8_t HM[F25519_SIZE];
struct tc_sha256_state_struct stx;

//Process Parameters
uint8_t c_i[F25519_SIZE], r_i_x[F25519_SIZE], r_i_y[F25519_SIZE], sum_hash[F25519_SIZE];
uint8_t e_i[ED25519_EXPONENT_SIZE];
uint8_t s_i[F25519_SIZE];
uint8_t HM_A[F25519_SIZE]; 
uint8_t HM_SUM[F25519_SIZE];
struct ed25519_pt RK_I;

//Performance Parameters (Time Measurements)
timing_t stA, etA;
uint64_t tA_cycles;
uint64_t tA_ns;

// =============================================================================================================================================

static void displayHex(const uint8_t *hex){
    int i;
    printf(" ");
    for (i = 0; i < F25519_SIZE; i++){
        printf("%02x", hex[i]);
    }
    printf("\n");
}

static void print_point(const uint8_t *x, const uint8_t *y)
{
    int i;

    printf("  ");
    for (i = 0; i < F25519_SIZE; i++)
        printf("%02x", x[i]);
    printf(", ");
    for (i = 0; i < F25519_SIZE; i++)
        printf("%02x", y[i]);
    printf("\n");
}

static void GenKey(uint8_t *key){
    timing_t start_time, end_time;
    uint64_t total_cycles;
    uint64_t total_ns;

    //timing_init();
    //timing_start();
    start_time = timing_counter_get();
    for (int i = 0; i < ED25519_EXPONENT_SIZE; i++){
        key[i] = rand();
    }
    c25519_prepare(key);
    end_time = timing_counter_get();

    total_cycles = timing_cycles_get(&start_time, &end_time);
    total_ns = timing_cycles_to_ns(total_cycles);
    //timing_stop();

    displayHex(key);

}


static void performExp(struct ed25519_pt *out, struct ed25519_pt *base, uint8_t * pwr, uint8_t *ax, uint8_t *ay){
    ed25519_smult(out, base, pwr);
    ed25519_unproject(ax, ay, out);

    print_point(ax, ay);
}




static void Hash256(uint8_t *digest, const char *msg, struct tc_sha256_state_struct stx){
    (void)tc_sha256_init(&stx);
    tc_sha256_update(&stx, (const uint8_t *)msg, strlen(msg));
    (void)tc_sha256_final(digest, &stx);
}




void main(void)
{
    timing_t st, et;
    uint64_t total_cycles;
    uint64_t total_ns;
    srand(546);

    timing_init();
    timing_start();


    //Generate Private key using a random generator
    printf("KM Key Generation Process ....\n");
    printf("SK_A:");
    GenKey(SK_S);
    printf("\n");

    //Generate DA public key using the ed25519 base generator 
    st = timing_counter_get();
    //ed25519_smult(&PK_S, &ed25519_base, SK_S);
    printf("DA Key:KM :");
    performExp(&PK_S, &ed25519_base, SK_S, pks_x, pks_y);
    //ed25519_unproject(pks_x, pks_y, &PK_S);
    et = timing_counter_get();
    total_cycles = timing_cycles_get(&st, &et);
    total_ns = timing_cycles_to_ns(total_cycles);

    //double t = (double)total_ns / 1000000000;

    printf("\nExp Time = %lld nano seconds\n\n", total_ns);

    //Key Generation at User A
    printf("SK_A:");
    GenKey(SK_A);                                               // k_i
    printf("\n");
    
    f25519_inv(tk_a, SK_A);                                     // 1/k_i
    
    printf("Transfer Key for A:");
    performExp(&TK_A, &ed25519_base, tk_a, tka_x, tka_y);       // rk_A = h^(1/k_i)
    printf("\n");

    //KM ReKey Process
    printf("ReKey for A:KM:");
    performExp(&RKA_S, &TK_A, SK_S, rka_x, rka_y);              // rk_i_s = (h^(1/k_i))^k
    printf("\n");

    //Process Function -> KM
    const uint8_t x_i[F25519_SIZE] = {
                                    0x4e, 0xdb, 0x9d, 0x4d, 0xa2, 0xd9, 0x11, 0x7f,
                                    0xad, 0x01, 0xf4, 0x36, 0x7b, 0x03, 0xd9, 0xa3,
                                    0x87, 0xe7, 0x58, 0x8e, 0x96, 0x21, 0xac, 0xf6,
                                    0x84, 0xc1, 0x46, 0xbc, 0xd2, 0x28, 0x24, 0x1b
                                };

    //Multiply key and message (k_i.x_i_t) + H(t)
    const char *tmstmp = "255";
    stA = timing_counter_get();
    Hash256(HM, tmstmp, stx);                                   // H(t)
    printf("Hashed Timestamp (255):");
    displayHex(HM);
    printf("\n");

    f25519_mul(c_i, x_i, SK_A);                                 // k_i * x_i_t
    f25519_add(c_i, c_i, HM);                                   // c_i = k_i * x_i_t + H(t)
    printf("First-Level Cipher:");
    displayHex(c_i);
    printf("\n");

    printf("E_I: ");
    GenKey(e_i);
    printf("\n");

    printf("Process Key:A :");
    performExp(&RK_I, &ed25519_base, e_i, r_i_x, r_i_y);        // r_i_t = h^(e_i_t)
    printf("\n");

    f25519_add(e_i, e_i, x_i);                                  // e_i = x_i + e_i_t
    
    //H(t||r_i_t) = Using addition to simplify the implementation
    f25519_add(sum_hash, r_i_x, r_i_y);
    f25519_add(sum_hash, sum_hash, (uint8_t *)tmstmp);
    Hash256(HM_SUM, (char *)sum_hash, stx);

    f25519_add(s_i, e_i, HM_SUM);                               // (x_i + e_i_t + H(t||r_i_t))
    f25519_mul(s_i, SK_A, s_i);                                 // k_i(x_i + e_i_t + H(t||r_i_t))

    printf("First-Level Tag:");
    displayHex(s_i);
    printf("\n");

    etA = timing_counter_get();
    tA_cycles = timing_cycles_get(&stA, &etA);
    tA_ns = timing_cycles_to_ns(tA_cycles);

    printf("\nProcess Function Time = %lld nano seconds\n", tA_ns);

    printf("Process Completed\n");
    timing_stop();
}
```

## src/main - TL.c
```c
#include <zephyr.h>
#include <sys/printk.h>

#include <stdio.h>
#include <stdlib.h>
#include <timing/timing.h>
#include <time.h>

#include "../c25519/src/c25519.h"
#include "../c25519/src/ed25519.h"
#include "../c25519/src/sha256.h"

 // Key Manager Functions
uint8_t SK_S[ED25519_EXPONENT_SIZE];
uint8_t pks_x[F25519_SIZE];
uint8_t pks_y[F25519_SIZE];
struct ed25519_pt PK_S;


//Performance Parameters (Time Measurements)
timing_t stA, etA;
uint64_t tA_cycles;
uint64_t tA_ns;
const char *tmstmp = "255";


typedef struct {
    char ID[5];
    uint8_t k_i[F25519_SIZE];                   //self-generated secret key
    uint8_t tk_i_x[F25519_SIZE];                //self-generated transfer key based on k_i
    uint8_t tk_i_y[F25519_SIZE];
    uint8_t rk_i_x[F25519_SIZE];                //re-key key generated by KM based on received tk_i
    uint8_t rk_i_y[F25519_SIZE];
    uint8_t rt_i_x[F25519_SIZE];                //part of the first level tag
    uint8_t rt_i_y[F25519_SIZE];
    uint8_t c_i[F25519_SIZE];
    uint8_t s_i[F25519_SIZE];
} Rusers;

Rusers RU[5000];
int cnt = 500;
// =============================================================================================================================================

static void displayHex(const uint8_t *hex){
    int i;
    printf(" ");
    for (i = 0; i < F25519_SIZE; i++){
        printf("%02x", hex[i]);
    }
    printf("\n");
}

static void print_point(const uint8_t *x, const uint8_t *y)
{
    int i;

    printf("  ");
    for (i = 0; i < F25519_SIZE; i++)
        printf("%02x", x[i]);
    printf(", ");
    for (i = 0; i < F25519_SIZE; i++)
        printf("%02x", y[i]);
    printf("\n");
}

static void GenKey(uint8_t *key){
    //timing_t start_time, end_time;
    //uint64_t total_cycles;
    //uint64_t total_ns;

    //timing_init();
    //timing_start();
    //start_time = timing_counter_get();
    for (int i = 0; i < ED25519_EXPONENT_SIZE; i++){
        key[i] = rand();
    }
    c25519_prepare(key);
    //end_time = timing_counter_get();

    //total_cycles = timing_cycles_get(&start_time, &end_time);
    //total_ns = timing_cycles_to_ns(total_cycles);
    //timing_stop();

    displayHex(key);

}


static void performExp(struct ed25519_pt *out, struct ed25519_pt *base, uint8_t * pwr, uint8_t *ax, uint8_t *ay){
    ed25519_smult(out, base, pwr);
    ed25519_unproject(ax, ay, out);

    print_point(ax, ay);
}


static void Hash256(uint8_t *digest, const char *msg, struct tc_sha256_state_struct stx){
    (void)tc_sha256_init(&stx);
    tc_sha256_update(&stx, (const uint8_t *)msg, strlen(msg));
    (void)tc_sha256_final(digest, &stx);
}

static void ProcessFunction(Rusers *U){         //Process Function run by each user
    for (int i = 0; i<cnt; i++)
    {
        snprintf(U[i].ID, 5, "%d", i);
        uint8_t x_i[F25519_SIZE];
        uint8_t k_i[ED25519_EXPONENT_SIZE], tk_i[ED25519_EXPONENT_SIZE];
        uint8_t tki_x[F25519_SIZE], tki_y[F25519_SIZE];
        struct ed25519_pt TK_I;

        //Hash Parameters
        uint8_t HM[F25519_SIZE];
        struct tc_sha256_state_struct stx;

        //Process Parameters
        uint8_t c_i[F25519_SIZE], r_i_x[F25519_SIZE], r_i_y[F25519_SIZE], sum_hash[F25519_SIZE];
        uint8_t e_i[ED25519_EXPONENT_SIZE];
        uint8_t s_i[F25519_SIZE];
        uint8_t HM_SUM[F25519_SIZE];
        struct ed25519_pt RK_I;

        //random x_i
        for (int j = 0; j < F25519_SIZE; j++){
            x_i[j] = rand();
        }
        printf("x_i = ");
        displayHex(x_i);
        printf("\n");

        printf("K_I:");
        GenKey(k_i);                                               // k_i
        f25519_copy(U[i].k_i, k_i);
        printf("\n");

        f25519_inv(tk_i, k_i);                                     // 1/k_i
        
        printf("Transfer Key for A:");
        performExp(&TK_I, &ed25519_base, tk_i, tki_x, tki_y);       // rk_A = h^(1/k_i)
        printf("\n");
        f25519_copy(U[i].tk_i_x, tki_x);
        f25519_copy(U[i].tk_i_y, tki_y);

        //Multiply key and message (k_i.x_i_t) + H(t)
        Hash256(HM, tmstmp, stx);                                   // H(t)
        printf("Hashed Timestamp (255):");
        displayHex(HM);
        printf("\n");

        f25519_mul(c_i, x_i, k_i);                                 // k_i * x_i_t
        f25519_add(c_i, c_i, HM);                                   // c_i = k_i * x_i_t + H(t)
        printf("First-Level Cipher:");
        displayHex(c_i);
        f25519_copy(U[i].c_i, c_i);
        printf("\n");

        printf("E_I: ");
        GenKey(e_i);
        printf("\n");

        printf("Process Key:A :");
        performExp(&RK_I, &ed25519_base, e_i, r_i_x, r_i_y);        // r_i_t = h^(e_i_t)
        printf("\n");
        f25519_copy(U[i].rt_i_x, r_i_x);
        f25519_copy(U[i].rt_i_y, r_i_y);

        f25519_add(e_i, e_i, x_i);                                  // e_i = x_i + e_i_t
        
        //H(t||r_i_t) = Using addition to simplify the implementation
        f25519_add(sum_hash, r_i_x, r_i_y);
        f25519_add(sum_hash, sum_hash, (uint8_t *)tmstmp);
        Hash256(HM_SUM, (char *)sum_hash, stx);

        f25519_add(s_i, e_i, HM_SUM);                              // (x_i + e_i_t + H(t||r_i_t))
        f25519_mul(s_i, k_i, s_i);                                 // k_i(x_i + e_i_t + H(t||r_i_t))
        f25519_copy(U[i].s_i, s_i);

        printf("First-Level Tag (%d):", i);
        displayHex(s_i);
        printf("\n");
        printf("==================================================================================================\n\n");
    }    
}

static void reKey(Rusers *U, uint8_t *key){
    for (int i = 0; i < cnt; i++){
        //Rekey Parameters
        uint8_t rki_x[F25519_SIZE], rki_y[F25519_SIZE];
        struct ed25519_pt RKI_S;
        struct ed25519_pt TK_I;

        ed25519_project(&TK_I, U[i].tk_i_x, U[i].tk_i_y);


        //KM ReKey Process
        printf("ReKey for User %s:KM:", U[i].ID);
        performExp(&RKI_S, &TK_I, key, rki_x, rki_y);              // rk_i_s = (h^(1/k_i))^k
        printf("\n");

        f25519_copy(U[i].rk_i_x, rki_x);
        f25519_copy(U[i].rk_i_y, rki_y);
    }
}

static void reProcess(Rusers *U){
    for (int i = 0; i < cnt; i++){
        //reProcess Parameters
        struct ed25519_pt cprime_i; 
        struct ed25519_pt sprime_i;
        struct ed25519_pt RKI_S;

        uint8_t c_sub[F25519_SIZE];
        uint8_t cprime_x[F25519_SIZE], cprime_y[F25519_SIZE];
        uint8_t sprime_x[F25519_SIZE], sprime_y[F25519_SIZE];

        //Hash Parameters
        uint8_t HM[F25519_SIZE];
        struct tc_sha256_state_struct stx;

        Hash256(HM, tmstmp, stx);                   // H(t)
        ed25519_project(&RKI_S, U[i].rk_i_x, U[i].rk_i_y);

        f25519_sub(c_sub, U[i].c_i, HM);            // c_i_t - H(t)

        printf("ReProcess for User %s:(C'):", U[i].ID);
        performExp(&cprime_i, &RKI_S, c_sub, cprime_x, cprime_y);
        printf("\n");

        printf("ReProcess for User %s:(S'):", U[i].ID);
        performExp(&sprime_i, &RKI_S, U[i].s_i, sprime_x, sprime_y);
        printf("\n");

    }
}


void main(void)
{
    //timing_t st, et;
    //uint64_t total_cycles;
    //uint64_t total_ns;
    srand(34799);

    clock_t pr1, pr2, rk1, rk2, rp1, rp2;
    double prT, rkT, rpT;

    //timing_init();
    //timing_start();

    //Generate Private key using a random generator
    printf("KM Key Generation Process ....\n");
    printf("SK_S:");
    GenKey(SK_S);
    printf("\n");

    //Generate DA public key using the ed25519 base generator 
    //st = timing_counter_get();
    printf("DA Key:KM :");
    performExp(&PK_S, &ed25519_base, SK_S, pks_x, pks_y);
    //et = timing_counter_get();
    //total_cycles = timing_cycles_get(&st, &et);
    //total_ns = timing_cycles_to_ns(total_cycles);

    //printf("\nExp Time = %lld nano seconds\n\n", total_ns);

    pr1 = clock();
    ProcessFunction(RU);
    pr2 = clock();
    prT = ((double)(pr2-pr1)) / CLOCKS_PER_SEC;
    //etA = timing_counter_get();
    //tA_cycles = timing_cycles_get(&stA, &etA);
    //tA_ns = timing_cycles_to_ns(tA_cycles);
    //printf("\nProcess Time for %d users = %lld nano seconds\n\n", cnt, tA_ns);

    printf("reKey Function ========================================================================= \n\n");
    rk1 = clock();
    reKey(RU, SK_S);
    rk2 = clock();
    rkT = ((double)(rk2-rk1)) / CLOCKS_PER_SEC;
    printf("reProcess Function ========================================================================= \n\n");
    rp1 = clock();
    reProcess(RU);
    rp2 = clock();
    rpT = ((double)(rp2-rp1)) / CLOCKS_PER_SEC;

    printf("Total execution time for Processing %d users = %f seconds\n", cnt, prT);
    printf("Total execution time for reKeying %d users = %f seconds\n", cnt, rkT);
    printf("Total execution time for reProcessing %d users = %f seconds\n", cnt, rpT);
    /*
    for (int j = 0; j < cnt; j++){
        printf("User %s variables: \n", RU[j].ID);
        displayHex(RU[j].k_i);
        printf("\n");
        displayHex(RU[j].c_i);
        printf("\n");
        displayHex(RU[j].s_i); 
    }
    */
    
    


    //KM ReKey Process
    /*
    printf("ReKey for A:KM:");
    performExp(&RKA_S, &TK_A, SK_S, rka_x, rka_y);              // rk_i_s = (h^(1/k_i))^k
    printf("\n");
    */

    printf("Process Completed\n");
    //timing_stop();
}
```

## src/main - extended.c
```c
#include <zephyr.h>
#include <sys/printk.h>

#include <stdio.h>
#include <stdlib.h>
#include <timing/timing.h>

#include "../c25519/src/c25519.h"
#include "../c25519/src/ed25519.h"
#include "../c25519/src/sha256.h"

// Aggregator Functions
uint8_t K_A[ED25519_EXPONENT_SIZE];
uint8_t pka_x[F25519_SIZE];
uint8_t pka_y[F25519_SIZE];
struct ed25519_pt PK_A;


//Parameters for User A
uint8_t SK_I[ED25519_EXPONENT_SIZE], tk_i[ED25519_EXPONENT_SIZE];
uint8_t tki_x[F25519_SIZE], tki_y[F25519_SIZE];
struct ed25519_pt TK_I;

//Process Parameters
uint8_t E_I[ED25519_EXPONENT_SIZE], S_I[ED25519_EXPONENT_SIZE];
uint8_t tmp1[ED25519_EXPONENT_SIZE], tmp2[ED25519_EXPONENT_SIZE];
struct ed25519_pt R_I;
struct ed25519_pt C_1;
struct ed25519_pt C_2;
struct ed25519_pt tmp3;
struct ed25519_pt tmp4;

//Hash Parameters
uint8_t HM1[F25519_SIZE], HM2[F25519_SIZE];
struct tc_sha256_state_struct stx;


//Performance Parameters (Time Measurements)
//timing_t stA, etA;
//uint64_t tA_cycles;
//uint64_t tA_ns;

// =============================================================================================================================================


const char *tmstmp = "20220216";

static void displayHex(const uint8_t *hex){
    int i;
    printf(" ");
    for (i = 0; i < F25519_SIZE; i++){
        printf("%02x", hex[i]);
    }
    printf("\n");
}

static void print_point(const uint8_t *x, const uint8_t *y)
{
    int i;

    printf("  ");
    for (i = 0; i < F25519_SIZE; i++)
        printf("%02x", x[i]);
    printf(", ");
    for (i = 0; i < F25519_SIZE; i++)
        printf("%02x", y[i]);
    printf("\n");
}

static void ECDisplay(struct ed25519_pt *in)
{
    uint8_t x[F25519_SIZE], y[F25519_SIZE];
    ed25519_unproject(x, y, in);
    
    int i;

    printf("  ");
    for (i = 0; i < F25519_SIZE; i++)
        printf("%02x", x[i]);
    printf(", ");
    for (i = 0; i < F25519_SIZE; i++)
        printf("%02x", y[i]);
    printf("\n");
}

static void GenKey(uint8_t *key){
    //timing_t start_time, end_time;
    //uint64_t total_cycles;
    //uint64_t total_ns;

    //timing_init();
    //timing_start();
    //start_time = timing_counter_get();
    for (int i = 0; i < ED25519_EXPONENT_SIZE; i++){
        key[i] = rand();
    }
    c25519_prepare(key);
    //end_time = timing_counter_get();

    //total_cycles = timing_cycles_get(&start_time, &end_time);
    //total_ns = timing_cycles_to_ns(total_cycles);
    //timing_stop();

    displayHex(key);

}


static void performExp(struct ed25519_pt *out, struct ed25519_pt *base, uint8_t * pwr, uint8_t *ax, uint8_t *ay){
    ed25519_smult(out, base, pwr);
    ed25519_unproject(ax, ay, out);

    print_point(ax, ay);
}




static void Hash256(uint8_t *digest, const char *msg){
    (void)tc_sha256_init(&stx);
    tc_sha256_update(&stx, (const uint8_t *)msg, strlen(msg));
    (void)tc_sha256_final(digest, &stx);
}

static void PointMul(struct ed25519_pt *out, struct ed25519_pt *in1, struct ed25519_pt *in2){
    uint8_t ax[F25519_SIZE], ay[F25519_SIZE], bx[F25519_SIZE], by[F25519_SIZE], cx[F25519_SIZE], cy[F25519_SIZE];
    //ed25519_unproject(ax, ay, out);
    ed25519_unproject(bx, by, in1);
    ed25519_unproject(cx, cy, in2);

    f25519_mul(ax, bx, cx);
    f25519_mul(ay, by, cy);

    ed25519_project(out, ax, ay);
}


static void ProcessKey(uint8_t *KI){
    uint8_t r_i_x[F25519_SIZE], r_i_y[F25519_SIZE];
    
    //random plaintext value for test purposes
    const uint8_t x_i[F25519_SIZE] = {
                                    0x4e, 0xdb, 0x9d, 0x4d, 0xa2, 0xd9, 0x11, 0x7f,
                                    0xad, 0x01, 0xf4, 0x36, 0x7b, 0x03, 0xd9, 0xa3,
                                    0x87, 0xe7, 0x58, 0x8e, 0x96, 0x21, 0xac, 0xf6,
                                    0x84, 0xc1, 0x46, 0xbc, 0xd2, 0x28, 0x24, 0x1b
                                };
    //generate E_I
    printf("Parameter E_I ");
    GenKey(E_I);

    //generate R_I
    ed25519_smult(&R_I, &ed25519_base, E_I);
    ed25519_unproject(r_i_x, r_i_y, &R_I);
    printf("Paramter R_I");
    ECDisplay(&R_I);

    //Hash of Timestamp and E_I
    f25519_add(tmp1, E_I, (uint8_t *)tmstmp);
    Hash256(HM1, (char *)tmp1);
    printf("Hash of Timestamp and E_I = ");
    displayHex(HM1);

    //Multiply k_i * H(t||e_I)
    f25519_mul(tmp2, KI, HM1);
    //Ci_t(1)
    ed25519_smult(&C_1, &ed25519_base, tmp2);
    printf("First Level Ciphertext 1 = ");
    ECDisplay(&C_1);
    
    //h^x_i
    ed25519_smult(&tmp3, &ed25519_base, x_i);
    //Z^H(t||e_i)
    ed25519_smult(&tmp4, &ed25519_base, HM1);

    //Ci_t(2)
    PointMul(&C_2, &tmp3, &tmp4);
    printf("First Level Ciphertext 2 = ");
    ECDisplay(&C_2);

    //S_I
    f25519_add(tmp1, x_i, E_I);
    f25519_add(tmp2, r_i_x, r_i_y);
    f25519_add(tmp2, tmp2, (uint8_t *)tmstmp);
    Hash256(HM2, (char *)tmp2);
    printf("Hash of Timestamp and R_I = ");
    displayHex(HM2);

    f25519_add(tmp1, tmp1, HM2);
    f25519_mul(S_I, KI, tmp1);
    printf("First Level Verification Tag = ");
    displayHex(S_I);

}

void main(void)
{
    timing_t proc1, proc2;
    timing_t exp1, exp2;
    uint64_t total_cycles;
    uint64_t proc_ns, exp_ns;
    srand(1546);

    timing_init();
    
    timing_start();
    //Generate Private key using a random generator
    printf("Key Generation Process for the Aggregator....\n");
    printf("K_A:");
    GenKey(K_A);
    printf("\n");

    exp1 = timing_counter_get();
    ed25519_smult(&PK_A, &ed25519_base, K_A);
    exp2 = timing_counter_get();
    total_cycles = timing_cycles_get(&exp1, &exp2);
    exp_ns = timing_cycles_to_ns(total_cycles);

    //Key Generation at User A
    printf("SK_I:");
    GenKey(SK_I);                                               // k_i
    printf("\n");
    
    f25519_inv(tk_i, SK_I);                                     // 1/k_i
    
    printf("Transfer Key for A:");
    performExp(&TK_I, &PK_A, tk_i, tki_x, tki_y);               // rk_i = PK_A^(1/k_i)
    printf("\n");

    printf("Process Function ============================================================================================ \n");
    proc1 = timing_counter_get();
    ProcessKey(SK_I);
    proc2 = timing_counter_get();
    total_cycles = timing_cycles_get(&proc1, &proc2);
    proc_ns = timing_cycles_to_ns(total_cycles);

    printf("\nKey Process Function took %lld nano seconds\n\n", proc_ns);
    printf("One Exponentiation took %lld nano seconds\n\n", exp_ns);


    //timing_stop();
}
```
